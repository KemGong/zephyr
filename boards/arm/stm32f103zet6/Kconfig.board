## boards/arm/stm32f103zet6/Kconfig.board
```kconfig
# Waveshare Open103Z board configuration

# Copyright (c) 2020 Stefano Manni
# SPDX-License-Identifier: Apache-2.0

config BOARD_STM32F103ZET6
	bool "STM32F103ZET6 Board"
	depends on SOC_STM32F103XE
```

## boards/arm/stm32f103zet6/Kconfig.defconfig
```kconfig
# Waveshare Open103Z board configuration

# Copyright (c) 2020 Stefano Manni
# SPDX-License-Identifier: Apache-2.0

if BOARD_STM32F103ZET6

config BOARD
	default "stm32f103zet6"

endif # BOARD_STM32F103ZET6
```
